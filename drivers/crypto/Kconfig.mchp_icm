## drivers/crypto/Kconfig.mchp_icm
```kconfig
# Copyright (c) 2024 Microchip Technology Inc.
# SPDX-License-Identifier: Apache-2.0

config CRYPTO_MCHP_ICM
	bool "Microchip PIC32CX/SAM E5x ICM crypto driver"
	default y
	depends on DT_HAS_MICROCHIP_ICM_G1_ENABLED
	help
	  Enable the ICM (Integrity Check Monitor) hardware crypto driver
	  for Microchip PIC32CX SG and SAM E54/D51 devices.

	  This driver supports SHA-256 and SHA-224 hash computation using
	  the ICM hardware accelerator.

config CRYPTO_MCHP_ICM_MAX_SESSION
	int "Maximum number of concurrent ICM sessions"
	default 4
	depends on CRYPTO_MCHP_ICM
	help
	  Maximum number of concurrent hash sessions supported by the
	  ICM driver. Each session requires memory for descriptors and
	  hash output buffers.
```

## drivers/crypto/Kconfig.mchp_pukcc
```kconfig
# Copyright (c) 2025 Microchip Technology Inc.
# SPDX-License-Identifier: Apache-2.0

config CRYPTO_MCHP_PUKCC
	bool "Microchip PIC32CX/SAM E5x PUKCC crypto driver"
	default y
	depends on DT_HAS_MICROCHIP_PUKCC_G1_ENABLED
	help
	  Enable the PUKCC (Public Key Cryptographic Controller) hardware
	  crypto driver for Microchip PIC32CX SG and SAM E54/D51 devices.

	  This driver supports ECDSA P-256 signature verification and
	  RSA operations using the PUKCC hardware accelerator.

config CRYPTO_MCHP_PUKCC_MAX_SESSION
	int "Maximum number of concurrent PUKCC sessions"
	default 2
	depends on CRYPTO_MCHP_PUKCC
	help
	  Maximum number of concurrent sessions supported by the
	  PUKCC driver.
```

## dts/bindings/crypto/microchip,icm-g1.yaml
```yaml
# Copyright (c) 2024 Microchip Technology Inc.
# SPDX-License-Identifier: Apache-2.0

description: |
  Microchip ICM (Integrity Check Monitor) Generation 1 hardware
  cryptographic accelerator for SHA hash computation.

  Found on PIC32CX SG, SAM D51, and SAM E54 devices.

  The ICM peripheral provides:
    - SHA-1, SHA-224, and SHA-256 hash computation
    - Memory integrity monitoring (tamper detection)
    - DMA-based data processing

  Example devicetree configuration:

    icm: crypto@42002c00 {
        compatible = "microchip,icm-g1";
        reg = <0x42002c00 0x28>;
        interrupts = <132 0>;
        status = "okay";
    };

compatible: "microchip,icm-g1"

include: base.yaml

properties:
  reg:
    required: true
    description: ICM peripheral register base address and size

  interrupts:
    required: true
    description: ICM interrupt line
```

## dts/bindings/crypto/microchip,pukcc-g1.yaml
```yaml
# Copyright (c) 2025 Microchip Technology Inc.
# SPDX-License-Identifier: Apache-2.0

description: |
  Microchip PUKCC (Public Key Cryptographic Controller) Generation 1
  hardware cryptographic accelerator for asymmetric crypto operations.

  Found on PIC32CX SG, SAM D51, and SAM E54 devices.

  The PUKCC peripheral provides:
    - ECC (Elliptic Curve Cryptography) operations
    - ECDSA signature generation and verification
    - RSA encryption/decryption and signature operations
    - Modular arithmetic acceleration
    - Random number generation support

  Example devicetree configuration:

    pukcc: crypto@42003000 {
        compatible = "microchip,pukcc-g1";
        reg = <0x42003000 0x200>;
        status = "okay";
    };

compatible: "microchip,pukcc-g1"

include: base.yaml

properties:
  reg:
    required: true
    description: PUKCC peripheral register base address and size
```
