## drivers/i2c/target/Kconfig
```kconfig
# I2C Target configuration options

# Copyright (c) 2017 BayLibre, SAS
# SPDX-License-Identifier: Apache-2.0

#
# I2C options
#
menuconfig I2C_TARGET
	bool "I2C Target Drivers"
	help
	  Enable I2C Target Driver Configuration

if I2C_TARGET

config I2C_TARGET_INIT_PRIORITY
	int "Init priority"
	default 60
	help
	  I2C Target device driver initialization priority.

config I2C_TARGET_BUFFER_MODE
	bool "I2C target driver for buffer mode [EXPERIMENTAL]"
	select EXPERIMENTAL
	help
	  This is an option to enable buffer mode.

config I2C_TARGET_DUAL_ADDRESS
	bool "Enable dual-address support for I2C targets"
	default y
	help
	  Allow I2C target drivers to expose both a primary and secondary address.
	  When enabled, target drivers may update i2c_target_config.secondary_address
	  and i2c_target_config.target_address to reflect the addresses currently in
	  use.  Disable this to reduce structure size when dual-address targets are
	  never used.

# zephyr-keep-sorted-start
source "drivers/i2c/target/Kconfig.eeprom"
# zephyr-keep-sorted-stop

endif # I2C_TARGET
```
